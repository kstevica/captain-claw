#include "epd_ssd1681.h"

#include <SPI.h>

namespace epd {

static constexpr int kDc = 10, kCs = 11, kSck = 12, kMosi = 13, kRst = 9, kBusy = 8;
static constexpr uint32_t kSpiHz = 20000000;  // the controller's limit for writes

// Waveshare's waveforms for this panel (their ESP32-S3-ePaper-1.54 examples):
// 153 bytes of look-up table, then the gate voltage, the source voltages and VCOM.
static const uint8_t kFullLut[159] = {
    0x80, 0x48, 0x40, 0x00, 0x00, 0x00, 0x00, 0x00, 0x00, 0x00, 0x00, 0x00,
    0x40, 0x48, 0x80, 0x00, 0x00, 0x00, 0x00, 0x00, 0x00, 0x00, 0x00, 0x00,
    0x80, 0x48, 0x40, 0x00, 0x00, 0x00, 0x00, 0x00, 0x00, 0x00, 0x00, 0x00,
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    0x22, 0x17, 0x41, 0x00, 0x32, 0x20};

static const uint8_t kPartialLut[159] = {
    0x00, 0x40, 0x00, 0x00, 0x00, 0x00, 0x00, 0x00, 0x00, 0x00, 0x00, 0x00,
    0x80, 0x80, 0x00, 0x00, 0x00, 0x00, 0x00, 0x00, 0x00, 0x00, 0x00, 0x00,
    0x40, 0x40, 0x00, 0x00, 0x00, 0x00, 0x00, 0x00, 0x00, 0x00, 0x00, 0x00,
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    0x02, 0x17, 0x41, 0xB0, 0x32, 0x28};

// What the controller is set up for. Off: nothing is known about it (a boot,
// or its own deep sleep), so its registers and memory need setting from scratch.
enum class Setup : uint8_t { Off, Full, Partial };
static Setup setup = Setup::Off;

// The SPI bus, for one call (nothing else is on it).
struct Bus {
  Bus() { SPI.beginTransaction(SPISettings(kSpiHz, MSBFIRST, SPI_MODE0)); }
  ~Bus() { SPI.endTransaction(); }
};

static void cmd(uint8_t c) {
  digitalWrite(kDc, LOW);
  digitalWrite(kCs, LOW);
  SPI.transfer(c);
  digitalWrite(kCs, HIGH);
}

static void data(uint8_t d) {
  digitalWrite(kDc, HIGH);
  digitalWrite(kCs, LOW);
  SPI.transfer(d);
  digitalWrite(kCs, HIGH);
}

static void dataBytes(const uint8_t* bytes, size_t len) {
  digitalWrite(kDc, HIGH);
  digitalWrite(kCs, LOW);
  SPI.writeBytes(bytes, len);
  digitalWrite(kCs, HIGH);
}

// Low when it's idle. False: it never was within `ms`.
static bool waitIdle(uint32_t ms) {
  const uint32_t t0 = millis();
  while (digitalRead(kBusy) == HIGH) {
    if (millis() - t0 > ms) return false;
    delay(2);
  }
  return true;
}

static void pulseReset() {
  digitalWrite(kRst, LOW);
  delay(10);
  digitalWrite(kRst, HIGH);
  delay(10);
}

static void cursorHome() {
  cmd(0x4E);  // RAM X
  data(0x00);
  cmd(0x4F);  // RAM Y, counted down from the last row
  data(kHeight - 1);
  data(0x00);
}

static void loadLut(const uint8_t* lut) {
  cmd(0x32);
  dataBytes(lut, 153);
  waitIdle(1000);
  cmd(0x3F);
  data(lut[153]);
  cmd(0x03);
  data(lut[154]);
  cmd(0x04);
  data(lut[155]);
  data(lut[156]);
  data(lut[157]);
  cmd(0x2C);
  data(lut[158]);
}

// As the PaperColor's panel, each full refresh starts from a reset controller
// and its whole set-up: nothing left over from what ran before.
static void resetAndInit() {
  pulseReset();
  waitIdle(1000);
  cmd(0x12);  // software reset: all registers to their defaults
  waitIdle(1000);
  cmd(0x01);  // gates: 200 lines
  data(kHeight - 1);
  data(0x00);
  data(0x01);
  cmd(0x11);  // address order: X up, Y down
  data(0x01);
  cmd(0x44);  // the RAM window
  data(0x00);
  data((kWidth - 1) >> 3);
  cmd(0x45);
  data(kHeight - 1);
  data(0x00);
  data(0x00);
  data(0x00);
  cmd(0x3C);  // the border follows the white waveform
  data(0x01);
  cmd(0x18);  // the internal temperature sensor
  data(0x80);
  cmd(0x22);  // read it, and load the waveform settings
  data(0xB1);
  cmd(0x20);
  waitIdle(1000);
  cursorHome();
}

static void writeRam(uint8_t which, const uint8_t* frame) {
  cursorHome();
  cmd(which);
  dataBytes(frame, kFrameBytes);
}

static bool update(uint8_t sequence, uint32_t ms) {
  cmd(0x22);
  data(sequence);
  cmd(0x20);
  return waitIdle(ms);
}

void begin() {
  pinMode(kDc, OUTPUT);
  pinMode(kCs, OUTPUT);
  pinMode(kRst, OUTPUT);
  pinMode(kBusy, INPUT);
  digitalWrite(kCs, HIGH);
  digitalWrite(kRst, HIGH);
  SPI.begin(kSck, -1, kMosi, -1);
  setup = Setup::Off;
}

bool full(const uint8_t* frame) {
  Bus bus;
  const uint32_t t0 = millis();
  resetAndInit();
  loadLut(kFullLut);
  writeRam(0x26, frame);  // both copies: the next partial compares against it
  writeRam(0x24, frame);
  const bool ok = update(0xC7, 6000);
  setup = ok ? Setup::Full : Setup::Off;
  Serial.printf("[paper] full refresh %s, %lu ms\n", ok ? "done" : "TIMED OUT", (unsigned long)(millis() - t0));
  return ok;
}

bool partial(const uint8_t* frame, const uint8_t* shown) {
  Bus bus;
  const uint32_t t0 = millis();
  const bool fromScratch = setup == Setup::Off;
  if (setup != Setup::Partial) {
    if (fromScratch) resetAndInit();
    else pulseReset();  // (a reset pulse keeps the set-up and the memory; only the waveform changes)
    waitIdle(1000);
    loadLut(kPartialLut);
    cmd(0x37);  // display option: after a refresh the two RAM copies swap
    for (uint8_t d : {0x00, 0x00, 0x00, 0x00, 0x00, 0x40, 0x00, 0x00, 0x00, 0x00}) data(d);
    cmd(0x3C);  // the border stays
    data(0x80);
    cmd(0x22);  // clock and analog on
    data(0xC0);
    cmd(0x20);
    waitIdle(1000);
    setup = Setup::Partial;
  }
  if (fromScratch) writeRam(0x26, shown);
  writeRam(0x24, frame);
  const bool ok = update(0xCF, 3000);
  if (!ok) setup = Setup::Off;
  Serial.printf("[paper] partial refresh %s, %lu ms\n", ok ? "done" : "TIMED OUT", (unsigned long)(millis() - t0));
  return ok;
}

void sleep() {
  Bus bus;
  cmd(0x10);
  data(0x01);
  setup = Setup::Off;
}

}  // namespace epd
